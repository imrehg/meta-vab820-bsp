## conf/machine/include/vab820.inc
```bitbake
# Common settings for VAB-820 boards

include conf/machine/include/imx-base.inc
include conf/machine/include/tune-cortexa9.inc

SERIAL_CONSOLE = "115200 ttymxc1"

MACHINE_FEATURES += ""

KERNEL_IMAGETYPE = "uImage"
```

## conf/machine/vab820-quad.conf
```bitbake
#@TYPE: Machine
#@NAME: VIA VAB-820 Quad
#@SOC: i.MX6Q
#@DESCRIPTION: Machine configuration for VIA VAB-820 quad board
#@MAINTAINER: Gergely Imreh <gergelyimreh@via.com.tw>

require conf/machine/include/vab820.inc

SOC_FAMILY = "mx6:mx6q:vab820"

PREFERRED_PROVIDER_u-boot ?= "u-boot-vab820"
PREFERRED_PROVIDER_virtual/kernel ?= "linux-vab820"
PREFERRED_VERSION_linux-vab820 ?= "3.10.17"

KERNEL_DEVICETREE ?= "imx6q-vab820.dtb"

UBOOT_MACHINE ?= "mx6qvab820"

SERIAL_CONSOLE = "115200 ttymxc1"

MACHINE_FEATURES += ""

IMX_TEST_SUPPORT = "y"

DISTRO_FEATURES_append = " systemd"
VIRTUAL-RUNTIME_init_manager = "systemd"
MACHINE_FEATURES_BACKFILL_CONSIDERED = "rtc sysvinit"
```
